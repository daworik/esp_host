## esp_master/main/Kconfig.projbuild
```kconfig
menu "ESP-NOW Drone Hive Configuration"

    config DRONE_HIVE_MAX_DRONES
        int "Maximum number of drones"
        default 10
        range 1 20
        help
            Maximum number of drone agents that can be controlled by this master.

    config DRONE_HIVE_ENCRYPTION_KEY
        string "ESP-NOW Encryption Key (32 bytes hex)"
        default "1a2b3c4d5e6f7a8b9cadbecfd0e1f2031425364758697a8b9cadbecfd0e1f203"
        help
            PMK encryption key for ESP-NOW communication (64 hex characters = 32 bytes).
            Must match on all drones.

    config DRONE_HEARTBEAT_TIMEOUT_MS
        int "Drone heartbeat timeout (ms)"
        default 3000
        range 1000 10000
        help
            Time after which a drone is considered inactive if no telemetry received.

endmenu
```

## esp_slave/main/Kconfig.projbuild
```kconfig
menu "ESP-NOW Drone Agent Configuration"

    config DRONE_AGENT_DEFAULT_ID
        int "Default drone ID"
        default 1
        range 1 255
        help
            Default ID for this drone agent. Can be changed via CMD_SET_ID command.

    config DRONE_HIVE_ENCRYPTION_KEY
        string "ESP-NOW Encryption Key (32 bytes hex)"
        default "1a2b3c4d5e6f7a8b9cadbecfd0e1f2031425364758697a8b9cadbecfd0e1f203"
        help
            PMK encryption key for ESP-NOW communication (64 hex characters = 32 bytes).
            Must match the master controller.

    config MOTOR_STEP_PIN
        int "Motor STEP GPIO pin"
        default 5
        help
            GPIO pin for motor STEP signal.

    config MOTOR_DIR_PIN
        int "Motor DIR GPIO pin"
        default 6
        help
            GPIO pin for motor DIR signal.

    config MOTOR_MAX_PPS
        int "Maximum pulses per second"
        default 2000
        range 100 5000
        help
            Maximum motor speed in pulses per second.

    config TELEMETRY_INTERVAL_MS
        int "Telemetry reporting interval (ms)"
        default 1000
        range 100 10000
        help
            How often to send telemetry data to master.

endmenu
```

## esp_slave/sdkconfig.defaults
```kconfig
# ESP-NOW Drone Hive Agent - SDK Configuration Defaults

# CPU Configuration (ESP32-S3 optimized)
CONFIG_ESP32S3_DEFAULT_CPU_FREQ_240=y
CONFIG_ESP32S3_DATA_CACHE_64KB=y
CONFIG_ESP32S3_INSTRUCTION_CACHE_64KB=y

# FreeRTOS Configuration
CONFIG_FREERTOS_HZ=1000
CONFIG_FREERTOS_TIMER_TASK_PRIORITY=10
CONFIG_FREERTOS_TIMER_TASK_STACK_DEPTH=4096
CONFIG_FREERTOS_TASK_FUNCTION_WRAPPER=y

# WiFi Configuration for ESP-NOW
CONFIG_ESP32S3_WIFI_HW_TSF=y
CONFIG_ESP32S3_WIFI_STA_DISCONNECTED_OP=y
CONFIG_ESP32S3_WIFI_AMPDU_TX_ENABLED=y
CONFIG_ESP32S3_WIFI_AMPDU_RX_ENABLED=y
CONFIG_ESP32S3_WIFI_TX_BA_WIN=6
CONFIG_ESP32S3_WIFI_RX_BA_WIN=6
CONFIG_ESP32S3_WIFI_STATIC_RX_BUFFER_NUM=10
CONFIG_ESP32S3_WIFI_DYNAMIC_RX_BUFFER_NUM=32
CONFIG_ESP32S3_WIFI_DYNAMIC_TX_BUFFER_NUM=32
CONFIG_ESP_WIFI_SOFTAP_SUPPORT=n

# ESP-NOW Support
CONFIG_ESPNOW_ENABLED=y
CONFIG_ESP_NOW_SECURITY=y

# GPTimer Configuration (for motor control)
CONFIG_GPTIMER_ISR_IN_IRAM=y
CONFIG_GPTIMER_CTRL_FUNC_IN_IRAM=y

# ADC Configuration (for battery monitoring)
CONFIG_ADC_CAL_EFUSE_TP_ENABLE=y
CONFIG_ADC_CAL_EFUSE_VREF_ENABLE=y
CONFIG_ADC_CAL_LUT_ENABLE=y

# GPIO Configuration
CONFIG_GPIO_ISR_IN_IRAM=y

# Compiler Optimization
CONFIG_COMPILER_OPTIMIZATION_PERF=y
CONFIG_COMPILER_OPTIMIZATION_ASSERTIONS_DISABLE=y

# Watchdog Configuration
CONFIG_ESP_TASK_WDT_TIMEOUT_S=10
CONFIG_ESP_TASK_WDT_CHECK_IDLE_TASK_CPU0=y
CONFIG_ESP_TASK_WDT_CHECK_IDLE_TASK_CPU1=y

# Logging Configuration
CONFIG_LOG_DEFAULT_LEVEL_INFO=y
CONFIG_LOG_COLORS=y

# NVS Flash Storage
CONFIG_NVS_FLASH_ENCRYPTION=n
CONFIG_NVS_SECURE_READ_WRITE=n
```
